/*
 * ECU Simple Tuner – Arduino Uno firmware (C++)
 * Companion: ecu_tuner_aligned.py (PySide6)
 *
 * Board: Arduino Uno (ATmega328P) @ 16 MHz
 *
 * Outputs
 *   D6  INJ_A   – injector bank A  (cylinders 1+4 batch)
 *   D7  INJ_B   – injector bank B  (cylinders 2+3 batch)
 *   D8  IGN_A   – wasted-spark coil A (cyl 1+4)
 *   D9  IGN_B   – wasted-spark coil B (cyl 2+3)
 *   D12 FAN     – cooling fan relay
 *   D13 FP      – fuel pump relay
 *
 * Inputs
 *   D2  CRANK   – VR/Hall tooth interrupt (INT0)
 *   A0  MAP
 *   A1  TPS
 *   A2  ECT
 *   A3  IAT
 *   A4  BAT (via divider)
 *
 * Serial 115200: telemetry KEY:val pairs, commands SET:/CFG:/UPLOAD:/SAVE
 */

#include <EEPROM.h>
#include <avr/pgmspace.h>
#include <math.h>
#include "ecu_config.h"   /* generated by engine_setup_tool.py */

// ── Pin map ───────────────────────────────────────────────────
static const uint8_t PIN_INJ_A  = 6;
static const uint8_t PIN_INJ_B  = 7;
static const uint8_t PIN_IGN_A  = 8;
static const uint8_t PIN_IGN_B  = 9;
static const uint8_t PIN_FAN    = 12;
static const uint8_t PIN_FP     = 13;
static const uint8_t PIN_CRANK  = 2;   // INT0

static const uint8_t PIN_MAP = A0;
static const uint8_t PIN_TPS = A1;
static const uint8_t PIN_ECT = A2;
static const uint8_t PIN_IAT = A3;
static const uint8_t PIN_BAT = A4;

// ── Map geometry (must match Python ROWS/COLS) ────────────────
static const uint8_t ROWS = 9;
static const uint8_t COLS = 11;

// ── EEPROM layout (Uno = 1024 bytes) ──────────────────────────
// 0..1     magic
// 2..15    cfg
// 16..114  advance map  (99 × int8)
// 115..213 injector map (99 × uint8, 0.1 ms)
// 214..265 ECT temp×10 int16 (13) + ADC uint16 (13) = 52
// 266..309 IAT temp×10 int16 (11) + ADC uint16 (11) = 44
// 310..331 TPS ADC uint16 (11) = 22
static const int EE_MAGIC = 0;
static const int EE_CFG   = 2;
static const int EE_ADV   = 16;
static const int EE_INJ   = EE_ADV + ROWS * COLS;   // 115
static const int EE_ECT   = EE_INJ + ROWS * COLS;   // 214
static const int EE_IAT   = EE_ECT + 13 * 4;        // 266
static const int EE_TPS   = EE_IAT + 11 * 4;        // 310

static const uint16_t MAGIC = 0xEC02;  // includes sensor cal

// ── Runtime config (defaults from ecu_config.h) ───────────────
volatile uint8_t  gTeeth       = CFG_TEETH;
volatile uint8_t  gMissing     = CFG_MISSING;
volatile uint8_t  gTrigAngle   = CFG_TRIG_ANGLE;
volatile uint8_t  gCylinders   = CFG_CYLINDERS;
volatile uint16_t gRpmLimit    = CFG_RPM_LIMIT;
volatile uint8_t  gFanSetpoint = CFG_FAN_C;
volatile uint8_t  gUseTps      = CFG_LOAD_ALPHA_N;  // 1 = Alpha-N (TPS)

// Maps
int8_t  advMap[ROWS][COLS];
uint8_t injMap[ROWS][COLS];   // pulse width in 0.1 ms units

// Load / RPM bins (mirror tuner defaults)
const float rpmBins[COLS] = {
  250, 1050, 1850, 2650, 3450, 4250, 5050, 5850, 6650, 7450, 8250
};
const float mapBins[ROWS] = {
  0.10f, 0.225f, 0.35f, 0.475f, 0.60f, 0.725f, 0.85f, 0.975f, 1.10f
};
const float tpsBins[ROWS] = {
  0, 12.5f, 25, 37.5f, 50, 62.5f, 75, 87.5f, 100
};

// ── Crank decoder (PLL + missing-tooth phase ref) ─────────────
volatile uint32_t lastToothUs  = 0;
volatile uint32_t lastGapUs    = 0;
volatile uint16_t toothIndex   = 0;     // 0 .. physical-teeth-1 after gap
volatile uint8_t  syncLocked   = 0;
volatile uint16_t syncLosses   = 0;
volatile uint32_t toothPeriodUs = 0;    // PLL period estimate (µs / tooth)
volatile uint16_t rpmLive      = 0;
volatile float    crankDeg     = 0.0f;  // 0–360 crank (gap = 0°)
volatile uint8_t  toothErrors  = 0;

// PLL state (updated in ISR only)
static uint32_t pllExpectUs  = 0;      // predicted next edge time
static int32_t  pllIntegral  = 0;      // PI integral (µs scaled)
static uint8_t  pllGoodStreak = 0;     // consecutive in-window teeth
static uint8_t  pllSoftErr   = 0;

// Ignition / injection timing (updated in loop, used in ISR-safe copies)
volatile uint16_t ignAdvanceDeg = 10;   // deg BTDC
volatile uint16_t injPwUs       = 2000;
volatile uint16_t dwellTargetUs = 3000; // desired charge time (battery-comp)
volatile uint16_t dwellActualUs = 0;    // last measured dwell (telemetry)

// Injection request flags (set in crankISR, handled in serviceInjection)
volatile uint8_t  injAReq   = 0;
volatile uint8_t  injBReq   = 0;
volatile uint8_t  injBArmed = 0;   // arm B after gap until ~180° crossed

// Coil dwell state: 0=off, 1=charging (dwell), fire on transition to 0
volatile uint8_t  coilAState    = 0;
volatile uint8_t  coilBState    = 0;
volatile uint32_t coilAStartUs  = 0;
volatile uint32_t coilBStartUs  = 0;
volatile uint8_t  coilAFired    = 0;    // one spark per half-rev
volatile uint8_t  coilBFired    = 0;

// Dwell limits (µs) – from ecu_config.h (smart coils use short pulse)
static const uint16_t DWELL_MIN_US = CFG_DWELL_MIN_US;
static const uint16_t DWELL_MAX_US = CFG_DWELL_MAX_US;
static const uint16_t DWELL_NOM_US = CFG_DWELL_NOM_US;

// Outputs state
volatile uint8_t fanOn = 0;
volatile uint8_t fpOn  = 0;

// Telemetry ADC
uint16_t adcMap, adcTps, adcEct, adcIat, adcBat;
float    engMap, engTps, engEct, engIat, engBat;

// Sensor calibration curves – seeded from ecu_config.h profiles
static const uint8_t ECT_PTS = CFG_ECT_N;
static const uint8_t IAT_PTS = CFG_IAT_N;
float    ectTemp[CFG_ECT_N];
uint16_t ectAdcT[CFG_ECT_N];
float    iatTemp[CFG_IAT_N];
uint16_t iatAdcT[CFG_IAT_N];
// TPS ADC at 0,10,...,100 %
uint16_t tpsAdcT[COLS] = { 100, 190, 280, 370, 460, 550, 640, 730, 820, 910, 1000 };

static void applyConfigProfiles() {
  for (uint8_t i = 0; i < CFG_ECT_N; i++) {
    ectTemp[i] = CFG_ECT_TEMP[i];
    ectAdcT[i] = CFG_ECT_ADC[i];
  }
  for (uint8_t i = 0; i < CFG_IAT_N; i++) {
    iatTemp[i] = CFG_IAT_TEMP[i];
    iatAdcT[i] = CFG_IAT_ADC[i];
  }
}

// Serial command buffer
static char     rxBuf[96];
static uint8_t  rxLen = 0;
static uint8_t  uploadMode = 0;  // 1=ADV 2=INJ
static uint8_t  uploadRow  = 0;

// ── Forward declarations (dwell / coils) ──────────────────────
static void scheduleCoils(uint32_t now);
static void serviceCoils();
static void updateDwellTarget();
static void coilCharge(uint8_t pin, volatile uint8_t *state,
                       volatile uint32_t *startUs, uint32_t now);
static void coilFire(uint8_t pin, volatile uint8_t *state,
                     volatile uint32_t *startUs, volatile uint8_t *fired);
static void coilOff(uint8_t pin, volatile uint8_t *state);

// ── Helpers ───────────────────────────────────────────────────
static inline uint32_t usNow() { return micros(); }

static int8_t clampAdv(int v) {
  if (v < -10) return -10;
  if (v > 45)  return 45;
  return (int8_t)v;
}
static uint8_t clampInj(float ms) {
  if (ms < 0)   ms = 0;
  if (ms > 20)  ms = 20;
  return (uint8_t)(ms * 10.0f + 0.5f);
}

static void defaultMaps() {
  for (uint8_t r = 0; r < ROWS; r++) {
    for (uint8_t c = 0; c < COLS; c++) {
      advMap[r][c] = clampAdv(10 + r * 0.8f + c);
      injMap[r][c] = clampInj(2.0f + r * 0.4f + c * 0.5f);
    }
  }
}

// ── EEPROM ────────────────────────────────────────────────────
static void saveEEPROM() {
  EEPROM.put(EE_MAGIC, MAGIC);
  EEPROM.write(EE_CFG + 0, gTeeth);
  EEPROM.write(EE_CFG + 1, gMissing);
  EEPROM.write(EE_CFG + 2, gTrigAngle);
  EEPROM.write(EE_CFG + 3, gCylinders);
  EEPROM.put(EE_CFG + 4, gRpmLimit);
  EEPROM.write(EE_CFG + 6, gFanSetpoint);
  EEPROM.write(EE_CFG + 7, gUseTps);

  int addr = EE_ADV;
  for (uint8_t r = 0; r < ROWS; r++)
    for (uint8_t c = 0; c < COLS; c++)
      EEPROM.write(addr++, (uint8_t)advMap[r][c]);
  for (uint8_t r = 0; r < ROWS; r++)
    for (uint8_t c = 0; c < COLS; c++)
      EEPROM.write(addr++, injMap[r][c]);

  addr = EE_ECT;
  for (uint8_t i = 0; i < ECT_PTS; i++) {
    int16_t t10 = (int16_t)(ectTemp[i] * 10.0f);
    EEPROM.put(addr, t10); addr += 2;
    EEPROM.put(addr, ectAdcT[i]); addr += 2;
  }
  addr = EE_IAT;
  for (uint8_t i = 0; i < IAT_PTS; i++) {
    int16_t t10 = (int16_t)(iatTemp[i] * 10.0f);
    EEPROM.put(addr, t10); addr += 2;
    EEPROM.put(addr, iatAdcT[i]); addr += 2;
  }
  addr = EE_TPS;
  for (uint8_t i = 0; i < COLS; i++) {
    EEPROM.put(addr, tpsAdcT[i]); addr += 2;
  }
}

static void loadEEPROM() {
  uint16_t magic = 0;
  EEPROM.get(EE_MAGIC, magic);
  // 0xEC01 = maps+cfg only (legacy); 0xEC02 = + sensor cal
  if (magic != MAGIC && magic != 0xEC01) {
    defaultMaps();
    return;
  }
  gTeeth       = EEPROM.read(EE_CFG + 0);
  gMissing     = EEPROM.read(EE_CFG + 1);
  gTrigAngle   = EEPROM.read(EE_CFG + 2);
  gCylinders   = EEPROM.read(EE_CFG + 3);
  EEPROM.get(EE_CFG + 4, gRpmLimit);
  gFanSetpoint = EEPROM.read(EE_CFG + 6);
  gUseTps      = EEPROM.read(EE_CFG + 7);
  if (gTeeth < 12 || gTeeth > 60) gTeeth = 36;
  if (gMissing >= gTeeth) gMissing = 1;

  int addr = EE_ADV;
  for (uint8_t r = 0; r < ROWS; r++)
    for (uint8_t c = 0; c < COLS; c++)
      advMap[r][c] = (int8_t)EEPROM.read(addr++);
  for (uint8_t r = 0; r < ROWS; r++)
    for (uint8_t c = 0; c < COLS; c++)
      injMap[r][c] = EEPROM.read(addr++);

  if (magic == MAGIC) {
    addr = EE_ECT;
    for (uint8_t i = 0; i < ECT_PTS; i++) {
      int16_t t10 = 0; uint16_t a = 0;
      EEPROM.get(addr, t10); addr += 2;
      EEPROM.get(addr, a);   addr += 2;
      ectTemp[i] = t10 / 10.0f;
      ectAdcT[i] = a;
    }
    addr = EE_IAT;
    for (uint8_t i = 0; i < IAT_PTS; i++) {
      int16_t t10 = 0; uint16_t a = 0;
      EEPROM.get(addr, t10); addr += 2;
      EEPROM.get(addr, a);   addr += 2;
      iatTemp[i] = t10 / 10.0f;
      iatAdcT[i] = a;
    }
    addr = EE_TPS;
    for (uint8_t i = 0; i < COLS; i++) {
      uint16_t a = 0;
      EEPROM.get(addr, a); addr += 2;
      tpsAdcT[i] = a;
    }
  }
}

// ── Crank ISR – PLL + missing-tooth phase reference ───────────
/*
 * Phase-locked loop tracks tooth rate; missing-tooth gap aligns phase (0°).
 *
 *   NCO:     pllExpectUs advances by toothPeriodUs each tooth
 *   Phase:   error = actual_edge − expected_edge  (µs, signed)
 *   Loop:    PI on period  (Kp≈1/8, Ki≈1/64) — integer, ISR-safe
 *   Gap:     dt ≈ (missing+1)×period → toothIndex = 0, phase reset
 *
 * Benefits vs plain EMA: resists noise, holds period through one bad edge,
 * stays locked at high RPM when gap edges are slightly jittered.
 */
void crankISR() {
  uint32_t now = usNow();
  uint32_t dt  = now - lastToothUs;
  if (dt < 50) return;                 // absolute debounce

  // Bootstrap first period
  if (toothPeriodUs == 0) {
    if (dt < 150 || dt > 80000UL) return;
    lastToothUs   = now;
    toothPeriodUs = dt;
    pllExpectUs   = now + dt;
    return;
  }

  uint32_t T = toothPeriodUs;
  uint8_t  miss = gMissing ? gMissing : 1;
  uint8_t  phys = gTeeth - miss;

  // Noise: ignore very early edges (do not move lastToothUs)
  uint32_t minTooth = (T >> 1) + (T >> 3);   // ~0.625 T
  if (minTooth < 80) minTooth = 80;
  if (dt < minTooth) {
    toothErrors++;
    return;
  }

  lastToothUs = now;

  // Gap window: (miss+1)*T  ±40%  (wide so lock survives jitter)
  uint32_t gapNom = T * (uint32_t)(miss + 1);
  uint32_t gapPad = gapNom / 2UL;            // ±50% of nominal gap
  if (gapPad < T) gapPad = T;
  uint32_t gapMin = (gapNom > gapPad) ? (gapNom - gapPad) : (T + (T >> 1));
  uint32_t gapMax = gapNom + gapPad;
  // Gap must be clearly longer than a normal tooth
  if (gapMin < T + (T >> 2)) gapMin = T + (T >> 2);

  uint8_t isGap = (dt >= gapMin && dt <= gapMax) ? 1 : 0;

  if (isGap) {
    // ---- GAP = absolute phase lock (tooth count is advisory only) ----
    if (lastGapUs != 0) {
      uint32_t revUs = now - lastGapUs;
      if (revUs >= 4000UL && revUs <= 300000UL) {
        uint32_t rpm = 60000000UL / revUs;
        if (rpm > 15000UL) rpm = 15000UL;
        rpmLive = (uint16_t)rpm;
        uint32_t tRev = revUs / (uint32_t)gTeeth;
        if (tRev >= 40 && tRev <= 50000UL)
          toothPeriodUs = (T * 3UL + tRev) / 4UL;
      }
    }

    lastGapUs    = now;
    toothIndex   = 0;
    crankDeg     = 0.0f;
    coilAFired   = 0;
    coilBFired   = 0;
    injAReq      = 1;
    injBArmed    = 1;
    pllSoftErr   = 0;
    pllGoodStreak++;
    // Lock after first valid gap once we have a period estimate
    if (pllGoodStreak >= 1)
      syncLocked = 1;

    // Mild period update from gap length
    uint32_t tGap = dt / (uint32_t)(miss + 1);
    if (tGap >= 40 && tGap <= 50000UL)
      toothPeriodUs = (toothPeriodUs * 3UL + tGap) / 4UL;

    pllExpectUs = now + toothPeriodUs;
  } else if (dt > gapMax) {
    // Extremely long — stalled or lost teeth; do not unlock yet (loop timeout will)
    toothErrors++;
    pllExpectUs = now + T;
  } else {
    // ---- Normal tooth ----
    // EMA period
    toothPeriodUs = (T * 7UL + dt) / 8UL;
    if (toothPeriodUs < 40) toothPeriodUs = 40;
    T = toothPeriodUs;
    pllExpectUs = now + T;

    if (syncLocked) {
      toothIndex++;
      // Soft wrap: if we overshoot, wait for real gap — do NOT unlock quickly
      if (toothIndex > phys + 8) {
        // Many extra teeth with no gap — true loss
        pllSoftErr++;
        if (pllSoftErr >= 5) {
          syncLocked    = 0;
          syncLosses++;
          toothIndex    = 0;
          injBArmed     = 0;
          pllSoftErr    = 0;
          pllGoodStreak = 0;
          rpmLive       = 0;
        }
      } else {
        float degPer  = 360.0f / (float)gTeeth;
        float prevDeg = crankDeg;
        if (toothIndex < gTeeth)
          crankDeg = (float)toothIndex * degPer;
        if (injBArmed && prevDeg < 180.0f && crankDeg >= 180.0f) {
          injBReq   = 1;
          injBArmed = 0;
        }
        if (pllSoftErr > 0) pllSoftErr--;
      }
    }

    // RPM from period between gaps
    if (toothPeriodUs > 40 && gTeeth > 0) {
      uint32_t rpm = 60000000UL / ((uint32_t)toothPeriodUs * (uint32_t)gTeeth);
      if (rpm > 15000UL) rpm = 15000UL;
      if (syncLocked && rpmLive > 0)
        rpmLive = (uint16_t)(((uint32_t)rpmLive * 3UL + rpm) / 4UL);
      else
        rpmLive = (uint16_t)rpm;
    }
  }

  // NOTE: scheduleCoils() is intentionally NOT called from this ISR.
  // Float-heavy coil math on every tooth exceeds Uno capacity above ~4–5k
  // on 60-tooth wheels. Loop calls serviceCoils() + scheduleCoils() instead.
}

/*
 * Coil dwell control (wasted spark)
 * ────────────────────────────────
 * Active-high charge: pin HIGH = current in primary, pin LOW = spark.
 * Target dwell time is battery-compensated (see updateDwellTarget).
 *
 * Fire angles (crank degrees after gap, before trig offset applied in map):
 *   Coil A (1+4): TDC near 0°/360°  → spark at (360 - advance - trig)
 *   Coil B (2+3): TDC near 180°     → spark at (180 - advance - trig)
 *
 * Dwell starts earlier by the angle equivalent of dwellTargetUs.
 * Max-dwell timeout in serviceCoils() prevents overheating if teeth are lost.
 */
static void coilCharge(uint8_t pin, volatile uint8_t *state,
                       volatile uint32_t *startUs, uint32_t now) {
  if (*state == 0) {
    digitalWrite(pin, HIGH);
    *state = 1;
    *startUs = now;
  }
}

static void coilFire(uint8_t pin, volatile uint8_t *state,
                     volatile uint32_t *startUs, volatile uint8_t *fired) {
  if (*state) {
    digitalWrite(pin, LOW);          // spark edge
    uint32_t dw = usNow() - *startUs;
    if (dw > 60000UL) dw = 60000UL;
    dwellActualUs = (uint16_t)dw;
    *state = 0;
  }
  *fired = 1;
}

static void coilOff(uint8_t pin, volatile uint8_t *state) {
  digitalWrite(pin, LOW);
  *state = 0;
}

static void scheduleCoils(uint32_t now) {
  // Rev-limit with hysteresis so a single RPM glitch does not kill spark forever
  static uint8_t limited = 0;
  if (rpmLive >= gRpmLimit) limited = 1;
  else if (rpmLive + 200 < gRpmLimit) limited = 0;

  if (!syncLocked || rpmLive < 80 || limited || toothPeriodUs < 40) {
    coilOff(PIN_IGN_A, &coilAState);
    coilOff(PIN_IGN_B, &coilBState);
    return;
  }

  // Degrees per microsecond at current speed: 360° per (toothPeriod * teeth) µs
  float usPerRev = (float)toothPeriodUs * (float)gTeeth;
  if (usPerRev < 400.0f) return;  // >~15000 rpm — skip rather than corrupt timing
  float degPerUs = 360.0f / usPerRev;
  float dwellDeg = (float)dwellTargetUs * degPerUs;
  // Cap dwell angle so charge never starts more than ~90° early
  if (dwellDeg > 90.0f) dwellDeg = 90.0f;
  if (dwellDeg < 2.0f)  dwellDeg = 2.0f;

  float band = 360.0f / (float)gTeeth;   // one tooth of tolerance
  float adv  = (float)ignAdvanceDeg;
  float trig = (float)gTrigAngle;

  // Spark crank angles (after gap = 0°)
  float fireA = 360.0f - adv - trig;
  float fireB = 180.0f - adv - trig;
  while (fireA < 0.0f) fireA += 360.0f;
  while (fireA >= 360.0f) fireA -= 360.0f;
  while (fireB < 0.0f) fireB += 360.0f;
  while (fireB >= 360.0f) fireB -= 360.0f;

  float dwellA = fireA - dwellDeg;
  float dwellB = fireB - dwellDeg;
  while (dwellA < 0.0f) dwellA += 360.0f;
  while (dwellB < 0.0f) dwellB += 360.0f;

  float deg = crankDeg;

#if CFG_COIL_SMART
  // Smart / logic-level coils: short fire pulse at spark angle only
  if (!coilAFired && deg >= fireA && deg < fireA + band * 2.0f) {
    coilCharge(PIN_IGN_A, &coilAState, &coilAStartUs, now);
  }
  if (coilAState && (now - coilAStartUs) >= (uint32_t)DWELL_NOM_US) {
    coilFire(PIN_IGN_A, &coilAState, &coilAStartUs, &coilAFired);
  }
  if (!coilBFired && deg >= fireB && deg < fireB + band * 2.0f) {
    coilCharge(PIN_IGN_B, &coilBState, &coilBStartUs, now);
  }
  if (coilBState && (now - coilBStartUs) >= (uint32_t)DWELL_NOM_US) {
    coilFire(PIN_IGN_B, &coilBState, &coilBStartUs, &coilBFired);
  }
#else
  // --- Coil A (dumb inductive – timed dwell) ---
  if (!coilAFired && !coilAState) {
    bool inDwell;
    if (dwellA <= fireA)
      inDwell = (deg >= dwellA && deg < fireA);
    else
      inDwell = (deg >= dwellA || deg < fireA);
    if (inDwell)
      coilCharge(PIN_IGN_A, &coilAState, &coilAStartUs, now);
  }
  if (coilAState && !coilAFired) {
    bool atFire = (deg >= fireA && deg < fireA + band * 2.0f);
    bool timeUp = (now - coilAStartUs) >= (uint32_t)dwellTargetUs;
    if (atFire || (timeUp && deg >= fireA - band))
      coilFire(PIN_IGN_A, &coilAState, &coilAStartUs, &coilAFired);
  }

  // --- Coil B ---
  if (!coilBFired && !coilBState) {
    bool inDwell;
    if (dwellB <= fireB)
      inDwell = (deg >= dwellB && deg < fireB);
    else
      inDwell = (deg >= dwellB || deg < fireB);
    if (inDwell)
      coilCharge(PIN_IGN_B, &coilBState, &coilBStartUs, now);
  }
  if (coilBState && !coilBFired) {
    bool atFire = (deg >= fireB && deg < fireB + band * 2.0f);
    bool timeUp = (now - coilBStartUs) >= (uint32_t)dwellTargetUs;
    if (atFire || (timeUp && deg >= fireB - band))
      coilFire(PIN_IGN_B, &coilBState, &coilBStartUs, &coilBFired);
  }
#endif
}

// Battery-compensated dwell target (call from loop)
// Higher voltage → shorter dwell for same energy; low voltage → longer.
static void updateDwellTarget() {
  // engBat is system voltage (after divider scaling)
  float v = engBat;
  if (v < 8.0f)  v = 8.0f;
  if (v > 16.0f) v = 16.0f;

  // Empirical: t ∝ 1/V² relative to 14.0 V nominal (inductive energy ~ I²L, I∝V)
  // Use milder 1/V curve to avoid huge dwell at 10 V
  float scale = 14.0f / v;
  float us = (float)DWELL_NOM_US * scale;
  if (us < (float)DWELL_MIN_US) us = (float)DWELL_MIN_US;
  if (us > (float)DWELL_MAX_US) us = (float)DWELL_MAX_US;

  // At very high RPM, available window shrinks – clamp by half-rev time
  if (rpmLive > 500 && toothPeriodUs > 50) {
    uint32_t halfRevUs = (uint32_t)toothPeriodUs * (uint32_t)gTeeth / 2UL;
    // Leave ≥25% of half-rev for spark recovery / scheduling margin
    uint32_t maxWin = (halfRevUs * 3UL) / 4UL;
    if (maxWin < DWELL_MIN_US) maxWin = DWELL_MIN_US;
    if (us > (float)maxWin) us = (float)maxWin;
  }

  noInterrupts();
  dwellTargetUs = (uint16_t)us;
  interrupts();
}

// Safety: force fire / abort if dwell exceeds hard maximum (lost teeth, etc.)
static void serviceCoils() {
  uint32_t now = usNow();
  if (coilAState && (now - coilAStartUs) > (uint32_t)DWELL_MAX_US + 500UL) {
    coilFire(PIN_IGN_A, &coilAState, &coilAStartUs, &coilAFired);
  }
  if (coilBState && (now - coilBStartUs) > (uint32_t)DWELL_MAX_US + 500UL) {
    coilFire(PIN_IGN_B, &coilBState, &coilBStartUs, &coilBFired);
  }
  // Match scheduleCoils hysteresis — do not latch coils off on one bad RPM sample
  if (!syncLocked || rpmLive >= gRpmLimit + 200) {
    coilOff(PIN_IGN_A, &coilAState);
    coilOff(PIN_IGN_B, &coilBState);
  }
}

// ── Sensors ───────────────────────────────────────────────────
static float adcToVolts(uint16_t a) {
  return a * (5.0f / 1023.0f);
}

// Piecewise-linear interpolate value from ADC using calibration table.
// adc[] may be ascending or descending (NTC is descending).
static float interpAdcTable(uint16_t adc, const uint16_t *adcT,
                            const float *valT, uint8_t n) {
  if (n < 2) return valT[0];
  // Ensure we walk from high-ADC toward low-ADC or vice versa
  bool desc = adcT[0] > adcT[n - 1];
  if (desc) {
    if (adc >= adcT[0]) return valT[0];
    if (adc <= adcT[n - 1]) return valT[n - 1];
    for (uint8_t i = 0; i < n - 1; i++) {
      if (adc <= adcT[i] && adc >= adcT[i + 1]) {
        float span = (float)adcT[i] - (float)adcT[i + 1];
        float t = span > 0 ? ((float)adcT[i] - (float)adc) / span : 0;
        return valT[i] + t * (valT[i + 1] - valT[i]);
      }
    }
  } else {
    if (adc <= adcT[0]) return valT[0];
    if (adc >= adcT[n - 1]) return valT[n - 1];
    for (uint8_t i = 0; i < n - 1; i++) {
      if (adc >= adcT[i] && adc <= adcT[i + 1]) {
        float span = (float)adcT[i + 1] - (float)adcT[i];
        float t = span > 0 ? ((float)adc - (float)adcT[i]) / span : 0;
        return valT[i] + t * (valT[i + 1] - valT[i]);
      }
    }
  }
  return valT[n / 2];
}

static float tpsFromAdc(uint16_t adc) {
  // Map ADC through 11-point closed→full curve to 0–100 %
  if (adc <= tpsAdcT[0]) return 0.0f;
  if (adc >= tpsAdcT[COLS - 1]) return 100.0f;
  for (uint8_t i = 0; i < COLS - 1; i++) {
    if (adc >= tpsAdcT[i] && adc <= tpsAdcT[i + 1]) {
      float span = (float)tpsAdcT[i + 1] - (float)tpsAdcT[i];
      float t = span > 0 ? ((float)adc - (float)tpsAdcT[i]) / span : 0;
      return (i + t) * (100.0f / (COLS - 1));
    }
  }
  return constrain(adc / 1023.0f * 100.0f, 0, 100);
}

// NTC: 5V — Rpull — ADC node — NTC — GND
// Returns °C; open/short ADCs clamped to ends
static float ntcBetaC(uint16_t adc) {
  if (adc < 2)   return 150.0f;   // shorted sensor (~0 V)
  if (adc > 1020) return -40.0f;  // open circuit (~5 V)
  // Rntc = Rpull * ADC / (1023 - ADC)
  float r = CFG_NTC_PULLUP_OHM * (float)adc / (1023.0f - (float)adc);
  if (r < 50.0f)   return 150.0f;
  if (r > 500000.0f) return -40.0f;
  // Beta: 1/T = 1/T0 + (1/B)*ln(R/R0)   T0 = 298.15 K (25 °C)
  float steinhart = logf(r / CFG_NTC_R0_OHM) / CFG_NTC_BETA;
  steinhart += 1.0f / 298.15f;
  float kelvin = 1.0f / steinhart;
  return kelvin - 273.15f;
}

// ── Digital filter design (sensor path) ───────────────────────
/*
 * Sampling: readSensors() runs every main-loop pass (~200–500 Hz typical).
 *
 * 1) Median-of-3   – non-linear, kills single-sample spikes (injector noise)
 * 2) 1st-order IIR – y += α (x − y)
 *      α ≈ 1 − exp(−2π fc / fs)
 *      With fs ≈ 250 Hz:
 *        MAP  fc≈15 Hz → α≈0.31  (load must track transients)
 *        TPS  fc≈25 Hz → α≈0.45  (throttle is fast)
 *        ECT  fc≈0.5 Hz → α≈0.012 (thermal mass is slow)
 *        IAT  fc≈2 Hz  → α≈0.05
 *        BAT  fc≈2 Hz  → α≈0.05
 *
 * Integer IIR for ADC: y = y + ((x − y) * K) >> 8   where K = α*256
 *   MAP K=80, TPS K=115, ECT K=3, IAT K=13, BAT K=13
 *
 * Crank path already uses a PI-PLL on tooth period (see crankISR) —
 * that is the rate loop; do not low-pass crank edges here.
 */

// Fixed-point IIR state (ADC counts × 1)
static uint16_t fMap = 512, fTps = 512, fEct = 512, fIat = 512, fBat = 512;
static uint8_t  filtInit = 0;

static uint16_t median3_u16(uint16_t a, uint16_t b, uint16_t c) {
  if (a > b) { uint16_t t = a; a = b; b = t; }
  if (b > c) { uint16_t t = b; b = c; c = t; }
  if (a > b) { uint16_t t = a; a = b; b = t; }
  return b;
}

static uint16_t readAdcMedian3(uint8_t pin) {
  uint16_t a = analogRead(pin);
  uint16_t b = analogRead(pin);
  uint16_t c = analogRead(pin);
  return median3_u16(a, b, c);
}

// y += (x - y) * K / 256   (K = 1..255)
static uint16_t iirU16(uint16_t y, uint16_t x, uint8_t K) {
  int16_t d = (int16_t)x - (int16_t)y;
  return (uint16_t)((int16_t)y + ((d * (int16_t)K) >> 8));
}

// Float IIR for engineering units (same α idea)
static float iirF(float y, float x, float alpha) {
  return y + alpha * (x - y);
}

static float fEngMap = 100.0f, fEngTps = 0.0f;
static float fEngEct = 20.0f,  fEngIat = 20.0f, fEngBat = 12.6f;

static void readSensors() {
  // Stage 1: median-of-3 on each channel (spike reject)
  uint16_t rawMap = readAdcMedian3(PIN_MAP);
  uint16_t rawTps = readAdcMedian3(PIN_TPS);
  uint16_t rawEct = readAdcMedian3(PIN_ECT);
  uint16_t rawIat = readAdcMedian3(PIN_IAT);
  uint16_t rawBat = readAdcMedian3(PIN_BAT);

  // Stage 2: 1st-order IIR on ADC (integer)
  if (!filtInit) {
    fMap = rawMap; fTps = rawTps; fEct = rawEct;
    fIat = rawIat; fBat = rawBat;
    filtInit = 1;
  } else {
    fMap = iirU16(fMap, rawMap, 80);   // ~15 Hz
    fTps = iirU16(fTps, rawTps, 115);  // ~25 Hz
    fEct = iirU16(fEct, rawEct, 3);    // ~0.5 Hz
    fIat = iirU16(fIat, rawIat, 13);   // ~2 Hz
    fBat = iirU16(fBat, rawBat, 13);   // ~2 Hz
  }

  adcMap = fMap;
  adcTps = fTps;
  adcEct = fEct;
  adcIat = fIat;
  adcBat = fBat;

  // Convert → engineering units
  float mapKpa = CFG_MAP_OFFSET_KPA + adcToVolts(adcMap) * CFG_MAP_GAIN_KPA_V;
  float tpsPct = tpsFromAdc(adcTps);
#if CFG_USE_NTC_TABLE
  float ectC = interpAdcTable(adcEct, ectAdcT, ectTemp, ECT_PTS);
  float iatC = interpAdcTable(adcIat, iatAdcT, iatTemp, IAT_PTS);
#else
  float ectC = ntcBetaC(adcEct);
  float iatC = ntcBetaC(adcIat);
#endif
  float batV = (adcBat * (CFG_BAT_ADC_REF_V / 1023.0f)) * CFG_BAT_DIVIDER;

  // Stage 3: light IIR on engineering units (smooth display / load)
  if (filtInit) {
    fEngMap = iirF(fEngMap, mapKpa, 0.35f);
    fEngTps = iirF(fEngTps, tpsPct, 0.50f);
    fEngEct = iirF(fEngEct, ectC,   0.08f);
    fEngIat = iirF(fEngIat, iatC,   0.15f);
    fEngBat = iirF(fEngBat, batV,   0.15f);
  } else {
    fEngMap = mapKpa; fEngTps = tpsPct;
    fEngEct = ectC;   fEngIat = iatC; fEngBat = batV;
  }

  engMap = fEngMap;
  engTps = fEngTps;
  engEct = fEngEct;
  engIat = fEngIat;
  engBat = fEngBat;
}

// ── Map lookup (bilinear) ─────────────────────────────────────
static void lookupMaps(float load, float rpm, int8_t *advOut, float *injOut) {
  // RPM axis
  uint8_t c0 = 0, c1 = COLS - 1;
  for (uint8_t i = 0; i < COLS - 1; i++) {
    if (rpm >= rpmBins[i] && rpm <= rpmBins[i + 1]) {
      c0 = i; c1 = i + 1; break;
    }
    if (rpm > rpmBins[COLS - 1]) { c0 = c1 = COLS - 1; }
    if (rpm < rpmBins[0])        { c0 = c1 = 0; }
  }
  const float *lb = gUseTps ? tpsBins : mapBins;
  uint8_t r0 = 0, r1 = ROWS - 1;
  for (uint8_t i = 0; i < ROWS - 1; i++) {
    if (load >= lb[i] && load <= lb[i + 1]) {
      r0 = i; r1 = i + 1; break;
    }
    if (load > lb[ROWS - 1]) { r0 = r1 = ROWS - 1; }
    if (load < lb[0])        { r0 = r1 = 0; }
  }

  float rf = (r1 == r0) ? 0 : (load - lb[r0]) / (lb[r1] - lb[r0]);
  float cf = (c1 == c0) ? 0 : (rpm - rpmBins[c0]) / (rpmBins[c1] - rpmBins[c0]);
  rf = constrain(rf, 0.0f, 1.0f);
  cf = constrain(cf, 0.0f, 1.0f);

  float a00 = advMap[r0][c0], a10 = advMap[r0][c1];
  float a01 = advMap[r1][c0], a11 = advMap[r1][c1];
  float adv = (1 - cf) * (1 - rf) * a00 + cf * (1 - rf) * a10
            + (1 - cf) * rf * a01 + cf * rf * a11;

  float i00 = injMap[r0][c0] * 0.1f, i10 = injMap[r0][c1] * 0.1f;
  float i01 = injMap[r1][c0] * 0.1f, i11 = injMap[r1][c1] * 0.1f;
  float inj = (1 - cf) * (1 - rf) * i00 + cf * (1 - rf) * i10
            + (1 - cf) * rf * i01 + cf * rf * i11;

  *advOut = clampAdv((int)(adv + 0.5f));
  *injOut = inj;
}

// ── Split-batch injection ─────────────────────────────────────
// Semi-sequential batch: bank A (1+4) on pin 6, bank B (2+3) on pin 7.
// ISR sets request flags at gap (0°) and ~180°; loop opens timed pulses.
static uint32_t injAEndUs = 0, injBEndUs = 0;
static uint8_t  injAOn = 0, injBOn = 0;

static void serviceInjection() {
  uint32_t now = micros();

  // Always honor pulse end times (even if sync drops mid-pulse)
  if (injAOn && (int32_t)(now - injAEndUs) >= 0) {
    digitalWrite(PIN_INJ_A, LOW);
    injAOn = 0;
  }
  if (injBOn && (int32_t)(now - injBEndUs) >= 0) {
    digitalWrite(PIN_INJ_B, LOW);
    injBOn = 0;
  }

  if (!syncLocked || rpmLive < 100) {
    if (injAOn) { digitalWrite(PIN_INJ_A, LOW); injAOn = 0; }
    if (injBOn) { digitalWrite(PIN_INJ_B, LOW); injBOn = 0; }
    injAReq = injBReq = 0;
    injBArmed = 0;
    return;
  }

  noInterrupts();
  uint8_t reqA = injAReq; injAReq = 0;
  uint8_t reqB = injBReq; injBReq = 0;
  uint16_t pw = injPwUs;
  interrupts();

  // Minimum practical open time (~0.8 ms) so drivers/injectors actually move
  if (pw < 800) pw = 800;
  if (pw > 20000) pw = 20000;

  if (reqA && !injAOn) {
    digitalWrite(PIN_INJ_A, HIGH);
    injAEndUs = now + pw;
    injAOn = 1;
  }
  if (reqB && !injBOn) {
    digitalWrite(PIN_INJ_B, HIGH);
    injBEndUs = now + pw;
    injBOn = 1;
  }
}

// ── Fuel pump & fan ───────────────────────────────────────────
static void serviceOutputs() {
  // Fuel pump: on when synced or RPM > 0, off after stall timeout
  static uint32_t lastRunMs = 0;
  uint32_t now = millis();
  if (syncLocked || rpmLive > 50) {
    lastRunMs = now;
    fpOn = 1;
  } else if (now - lastRunMs > 3000) {
    fpOn = 0;
  }
  digitalWrite(PIN_FP, fpOn ? HIGH : LOW);

  // Fan from ECT vs setpoint
  if (engEct >= gFanSetpoint) fanOn = 1;
  else if (engEct < gFanSetpoint - 3) fanOn = 0;
  digitalWrite(PIN_FAN, fanOn ? HIGH : LOW);

  // Rev limit handled in serviceCoils / scheduleCoils
}

// ── Serial protocol ───────────────────────────────────────────
static void sendTelemetry() {
  // Compact single line – matches Python _SERIAL_MAP
  Serial.print(F("RPM:")); Serial.print(rpmLive);
  Serial.print(F(",MAP:")); Serial.print(engMap, 2);
  Serial.print(F(",TPS:")); Serial.print(engTps, 0);
  Serial.print(F(",TMP:")); Serial.print(engEct, 1);
  Serial.print(F(",IAT:")); Serial.print(engIat, 1);
  Serial.print(F(",BAT:")); Serial.print(engBat, 2);
  Serial.print(F(",EADC:")); Serial.print(adcEct);
  Serial.print(F(",TADC:")); Serial.print(adcTps);
  Serial.print(F(",BADC:")); Serial.print(adcBat);
  Serial.print(F(",IADC:")); Serial.print(adcIat);
  Serial.print(F(",MADC:")); Serial.print(adcMap);
  Serial.print(F(",SYNC:")); Serial.print(syncLocked ? 1 : 0);
  Serial.print(F(",FAN:"));  Serial.print(fanOn ? 1 : 0);
  Serial.print(F(",FP:"));   Serial.print(fpOn ? 1 : 0);
  Serial.print(F(",IGN:"));  Serial.print(ignAdvanceDeg);
  Serial.print(F(",PW:"));   Serial.print(injPwUs / 1000.0f, 1);
  Serial.print(F(",LOST:")); Serial.print(syncLosses);
  Serial.print(F(",TOOTH:")); Serial.print(toothIndex);
  Serial.print(F(",DEG:"));  Serial.print(crankDeg, 0);
  Serial.print(F(",TERR:")); Serial.print(toothErrors);
  // Dwell target / last actual (ms) – optional keys ignored by older tuners
  Serial.print(F(",DWELL:")); Serial.print(dwellTargetUs / 1000.0f, 2);
  Serial.print(F(",DWLMS:")); Serial.print(dwellActualUs / 1000.0f, 2);
  Serial.println();
}

static void handleSet(const char *body) {
  // SET:X,r,c,val
  char tag = body[0];
  int r = 0, c = 0;
  float val = 0;
  if (sscanf(body + 2, "%d,%d,%f", &r, &c, &val) < 1) {
    // some commands use SET:X,0,0,val only
    sscanf(body + 2, "%d,%d,%f", &r, &c, &val);
  }

  switch (tag) {
    case 'A':
      if (r >= 0 && r < ROWS && c >= 0 && c < COLS)
        advMap[r][c] = clampAdv((int)val);
      break;
    case 'I':
      if (r >= 0 && r < ROWS && c >= 0 && c < COLS)
        injMap[r][c] = clampInj(val);
      break;
    case 'L':
      gUseTps = (uint8_t)val;
      break;
    case 'Y':
      gCylinders = constrain((int)val, 1, 8);
      break;
    case 'Q':
      gRpmLimit = constrain((int)val, 1000, 20000);
      break;
    case 'N':
      gFanSetpoint = constrain((int)val, 60, 120);
      break;
    case 'B':  // ECT temperature breakpoint °C  SET:B,i,0,temp
      if (r >= 0 && r < ECT_PTS) ectTemp[r] = val;
      break;
    case 'E':  // ECT ADC breakpoint            SET:E,i,0,adc
      if (r >= 0 && r < ECT_PTS) ectAdcT[r] = (uint16_t)constrain(val, 0, 1023);
      break;
    case 'T':  // legacy ECT compensation – ignored for conversion
      break;
    case 'J':  // IAT temperature breakpoint °C SET:J,i,0,temp
      if (r >= 0 && r < IAT_PTS) iatTemp[r] = val;
      break;
    case 'K':  // IAT ADC breakpoint            SET:K,i,0,adc
      if (r >= 0 && r < IAT_PTS) iatAdcT[r] = (uint16_t)constrain(val, 0, 1023);
      break;
    case 'P':  // TPS ADC at 0..100%            SET:P,i,0,adc
      if (r >= 0 && r < COLS) tpsAdcT[r] = (uint16_t)constrain(val, 0, 1023);
      break;
    default:
      break;
  }
}

static void handleCfg(const char *body) {
  int t = 36, m = 1, a = 30;
  if (sscanf(body, "%d,%d,%d", &t, &m, &a) >= 2) {
    if (t >= 12 && t <= 60 && m >= 0 && m < t && (t - m) >= 3) {
      noInterrupts();
      gTeeth = (uint8_t)t;
      gMissing = (uint8_t)m;
      gTrigAngle = (uint8_t)constrain(a, 0, 90);
      syncLocked = 0;
      toothPeriodUs = 0;
      toothIndex = 0;
      interrupts();
    }
  }
}

static void handleUploadLine(const char *line) {
  // comma-separated row of COLS values
  float vals[COLS];
  int n = 0;
  const char *p = line;
  while (n < COLS && *p) {
    vals[n++] = atof(p);
    while (*p && *p != ',') p++;
    if (*p == ',') p++;
  }
  if (n < COLS || uploadRow >= ROWS) {
    uploadMode = 0;
    uploadRow = 0;
    return;
  }
  if (uploadMode == 1) {
    for (uint8_t c = 0; c < COLS; c++)
      advMap[uploadRow][c] = clampAdv((int)vals[c]);
  } else if (uploadMode == 2) {
    for (uint8_t c = 0; c < COLS; c++)
      injMap[uploadRow][c] = clampInj(vals[c]);
  }
  uploadRow++;
  if (uploadRow >= ROWS) {
    uploadMode = 0;
    uploadRow = 0;
  }
}

static void handleLine(char *line) {
  while (*line == ' ' || *line == '\t') line++;
  if (!line[0]) return;

  if (uploadMode) {
    handleUploadLine(line);
    return;
  }

  if (!strncmp(line, "SET:", 4)) {
    handleSet(line + 4);
  } else if (!strncmp(line, "CFG:", 4)) {
    handleCfg(line + 4);
  } else if (!strncmp(line, "GETCFG", 6)) {
    // Tuner reads wheel / limits from MCU (EEPROM→RAM at boot)
    Serial.print(F("CFG:"));
    Serial.print(gTeeth); Serial.print(',');
    Serial.print(gMissing); Serial.print(',');
    Serial.print(gTrigAngle); Serial.print(',');
    Serial.print(gCylinders); Serial.print(',');
    Serial.print(gRpmLimit); Serial.print(',');
    Serial.print(gFanSetpoint); Serial.print(',');
    Serial.println(gUseTps ? 1 : 0);
  } else if (!strncmp(line, "GETMAP", 6)) {
    // Dump advance + injector maps (RAM = EEPROM after boot / last load)
    Serial.println(F("MAP:ADV"));
    for (uint8_t r = 0; r < ROWS; r++) {
      for (uint8_t c = 0; c < COLS; c++) {
        if (c) Serial.print(',');
        Serial.print((int)advMap[r][c]);
      }
      Serial.println();
    }
    Serial.println(F("MAP:INJ"));
    for (uint8_t r = 0; r < ROWS; r++) {
      for (uint8_t c = 0; c < COLS; c++) {
        if (c) Serial.print(',');
        // inj stored in 0.1 ms units
        Serial.print(injMap[r][c] / 10.0f, 1);
      }
      Serial.println();
    }
    Serial.println(F("MAP:END"));
  } else if (!strncmp(line, "UPLOAD:ADV", 10)) {
    uploadMode = 1; uploadRow = 0;
  } else if (!strncmp(line, "UPLOAD:INJ", 10)) {
    uploadMode = 2; uploadRow = 0;
  } else if (!strncmp(line, "SAVE", 4)) {
    saveEEPROM();
  }
}

static void pollSerial() {
  while (Serial.available()) {
    char ch = (char)Serial.read();
    if (ch == '\n' || ch == '\r') {
      if (rxLen > 0) {
        rxBuf[rxLen] = 0;
        handleLine(rxBuf);
        rxLen = 0;
      }
    } else if (rxLen < sizeof(rxBuf) - 1) {
      rxBuf[rxLen++] = ch;
    } else {
      rxLen = 0; // overflow – drop
    }
  }
}

// ── Setup / loop ──────────────────────────────────────────────
void setup() {
  pinMode(PIN_INJ_A, OUTPUT);
  pinMode(PIN_INJ_B, OUTPUT);
  pinMode(PIN_IGN_A, OUTPUT);
  pinMode(PIN_IGN_B, OUTPUT);
  pinMode(PIN_FAN,   OUTPUT);
  pinMode(PIN_FP,    OUTPUT);
  pinMode(PIN_CRANK, INPUT);   // external pull-up/VR conditioner assumed

  digitalWrite(PIN_INJ_A, LOW);
  digitalWrite(PIN_INJ_B, LOW);
  digitalWrite(PIN_IGN_A, LOW);
  digitalWrite(PIN_IGN_B, LOW);
  digitalWrite(PIN_FAN,   LOW);
  digitalWrite(PIN_FP,    LOW);

  applyConfigProfiles();  // sensor curves from ecu_config.h
  defaultMaps();
  loadEEPROM();           // EEPROM overrides config if previously saved

  Serial.begin(115200);

  attachInterrupt(digitalPinToInterrupt(PIN_CRANK), crankISR, RISING);
}

void loop() {
  pollSerial();
  readSensors();

  // mapBins are ~0.10–1.10 (bar-ish); engMap is kPa → convert for lookup
  float load = gUseTps ? engTps : (engMap / 100.0f);
  int8_t adv;
  float injMs;
  lookupMaps(load, (float)rpmLive, &adv, &injMs);

  noInterrupts();
  ignAdvanceDeg = (uint16_t)constrain((int)adv, 0, 45);
  // injMs from map (typically 1–15 ms); store microseconds for pulse timer
  injPwUs = (uint16_t)constrain((long)(injMs * 1000.0f), 800, 20000);
  // Sync loss if no tooth for too long
  // Unlock only after ~150 ms with no teeth (was 500 ms; still sticky vs noise)
  if (syncLocked && (usNow() - lastToothUs) > 150000UL) {
    syncLocked = 0;
    syncLosses++;
    rpmLive = 0;
    pllGoodStreak = 0;
  }
  interrupts();

  updateDwellTarget();
  // Coil scheduling runs in loop (not crank ISR) — keeps ISR short on Uno
  scheduleCoils(usNow());
  serviceCoils();
  serviceInjection();
  serviceOutputs();

  static uint32_t lastTel = 0;
  if (millis() - lastTel >= 50) {   // 20 Hz telemetry
    lastTel = millis();
    sendTelemetry();
  }
}
